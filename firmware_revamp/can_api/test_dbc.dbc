BO_ 11 BrakeLightStatus: 5 Vector__XXX
 SG_ ErrorCode: 0|8@0+ (1,0) [0|0] "n/a" Vector__XXX
 SG_ BrakeAnalogVoltageMSB: 8|8@0+ (10,0) [0|1] "bit" Vector__XXX
